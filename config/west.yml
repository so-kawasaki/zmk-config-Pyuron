## config/west.yml
```yaml
manifest:
  remotes:
    - name: zmkfirmware
      url-base: https://github.com/zmkfirmware
    - name: MeowCatpawkittie
      url-base: https://github.com/MeowCatpawkittie
    - name: caksoylar
      url-base: https://github.com/caksoylar
    - name: badjeff
      url-base: https://github.com/badjeff
  projects:
    - name: zmk
      remote: zmkfirmware
      revision: 197f8997776c960b6d2d368909895735f859a4b4
      import: app/west.yml
    - name: zmk-pmw3610-driver
      remote: badjeff
      revision: a1a0f35ab6750c8fc72b84ea00add1e5fbaea1e4
    - name: zmk-rgbled-widget
      remote: caksoylar
      revision: main
  self:
    path: config
```
